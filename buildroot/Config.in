## buildroot/configs/rock4d_npu_defconfig
```kconfig
BR2_aarch64=y

# External toolchain with path=/usr causes dangling-symlink failures on
# Ubuntu 24.04 aarch64; use the buildroot internal toolchain instead.
BR2_TOOLCHAIN_BUILDROOT_GLIBC=y
BR2_KERNEL_HEADERS_6_6=y
BR2_TOOLCHAIN_BUILDROOT_CXX=y
# RK3576 = Cortex-A72 (big) + Cortex-A53 (little), both ARMv8.0-A.
# cortex-a55 (ARMv8.2-A) emits LSE atomics that A72/A53 don't support → SIGILL.
BR2_TARGET_OPTIMIZATION="-mcpu=cortex-a72.cortex-a53"

BR2_TARGET_GENERIC_HOSTNAME="rock4d"
BR2_TARGET_GENERIC_ISSUE="RK3576 NPU bringup"
BR2_SYSTEM_DHCP="eth0"
BR2_TARGET_GENERIC_ROOT_PASSWD="root"
BR2_INIT_BUSYBOX=y

BR2_ROOTFS_OVERLAY="$(BR2_EXTERNAL_RK3576NPU_PATH)/../rootfs-overlay"
BR2_ROOTFS_POST_IMAGE_SCRIPT="$(BR2_EXTERNAL_RK3576NPU_PATH)/board/rock4d/post-image.sh"
BR2_ROOTFS_POST_SCRIPT_ARGS="$(BR2_EXTERNAL_RK3576NPU_PATH)"

# Kernel source is overridden at build time via LINUX_OVERRIDE_SRCDIR in local.mk;
# the version string below is a placeholder.
BR2_LINUX_KERNEL=y
BR2_LINUX_KERNEL_CUSTOM_VERSION=y
BR2_LINUX_KERNEL_CUSTOM_VERSION_VALUE="7.1.0-rc5-next"
BR2_LINUX_KERNEL_USE_CUSTOM_CONFIG=y
BR2_LINUX_KERNEL_CUSTOM_CONFIG_FILE="$(BR2_EXTERNAL_RK3576NPU_PATH)/../kernel/base.config"
BR2_LINUX_KERNEL_CONFIG_FRAGMENT_FILES="$(BR2_EXTERNAL_RK3576NPU_PATH)/../kernel/npu.fragment"
BR2_LINUX_KERNEL_IMAGE_TARGET_CUSTOM=y
BR2_LINUX_KERNEL_IMAGE_TARGET_NAME="Image"
BR2_LINUX_KERNEL_DTS_SUPPORT=y
BR2_LINUX_KERNEL_INTREE_DTS_NAME="rockchip/rk3576-rock-4d"
BR2_LINUX_KERNEL_NEEDS_HOST_OPENSSL=y
BR2_LINUX_KERNEL_INSTALL_TARGET=y

BR2_PACKAGE_BUSYBOX=y
BR2_PACKAGE_DROPBEAR=y
BR2_PACKAGE_LIBDRM=y
BR2_PACKAGE_PYTHON3=y
BR2_PACKAGE_PYTHON3_PY_LAUNCHER=y
BR2_PACKAGE_PYTHON_PIP=y
BR2_PACKAGE_PYTHON_SETUPTOOLS=y
BR2_PACKAGE_PYTHON_NUMPY=y

BR2_TARGET_ROOTFS_EXT2=y
BR2_TARGET_ROOTFS_EXT2_4=y
BR2_TARGET_ROOTFS_EXT2_SIZE="512M"
```
